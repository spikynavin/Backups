## Meta layer 75xx/conf/layer.conf
```bitbake
# We have a conf and classes directory, add to BBPATH
BBPATH .= ":${LAYERDIR}"

# We have recipes-* directories, add to BBFILES
BBFILES += "${LAYERDIR}/recipes-*/*/*.bb \${LAYERDIR}/recipes-*/*/*.bbappend"

BBFILE_COLLECTIONS += "hhc75xx"
BBFILE_PATTERN_hhc75xx = "^${LAYERDIR}/"
BBFILE_PRIORITY_hhc75xx-layer = "6"

LAYERVERSION_hhc75xx-layer = "1"

LAYERDEPENDS_hhc75xx-layer = "core openembedded-layer"

LAYERSERIES_COMPAT_hhc75xx = "sumo"
```
